## c3-assistant/main/Kconfig.projbuild
```kconfig
menu "ES8311 Configuration"

    choice ES8311_MODE
        prompt "ES8311 mode"
        default ES8311_MODE_MUSIC
        help
            Select ES8311 work mode

        config ES8311_MODE_MUSIC
            bool "music"
        config ES8311_MODE_ECHO
            depends on !ES8311_BSP
            bool "echo"
    endchoice

    choice ES8311_SELECT_MIC_GAIN
        prompt "Set MIC gain"
        depends on ES8311_MODE_ECHO
        default MIC_GAIN_18DB
        help
            Select mic gain for echo mode

        config MIC_GAIN_0DB
            bool "0dB"
        config MIC_GAIN_6DB
            bool "6dB"
        config MIC_GAIN_12DB
            bool "12dB"
        config MIC_GAIN_18DB
            bool "18dB"
        config MIC_GAIN_24DB
            bool "24dB"
        config MIC_GAIN_30DB
            bool "30dB"
        config MIC_GAIN_36DB
            bool "36dB"
        config MIC_GAIN_42DB
            bool "42dB"
    endchoice

    config ES8311_MIC_GAIN
        int
        default 0 if MIC_GAIN_0DB
        default 1 if MIC_GAIN_6DB
        default 2 if MIC_GAIN_12DB
        default 3 if MIC_GAIN_18DB
        default 4 if MIC_GAIN_24DB
        default 5 if MIC_GAIN_30DB
        default 6 if MIC_GAIN_36DB
        default 7 if MIC_GAIN_42DB

    config ES8311_VOICE_VOLUME
        int "Voice volume"
        range 0 100
        default 60
        help
            Set voice volume

    config ES8311_BSP
        bool "Enable Board Support Package (BSP) support"
        default n
        help
            Use BSP to setup all hardware settings. Specific board must be selected in main/idf_component.yml file.

    config SNTP_TIME_SERVER
        string "SNTP server name"
        default "pool.ntp.org"
        help
            Hostname of the main SNTP server.

    choice SNTP_TIME_SYNC_METHOD
        prompt "Time synchronization method"
        default SNTP_TIME_SYNC_METHOD_IMMED
        help
            Time synchronization method.

        config SNTP_TIME_SYNC_METHOD_IMMED
            bool "update time immediately when received"
        config SNTP_TIME_SYNC_METHOD_SMOOTH
            bool "update time with smooth method (adjtime)"
        config SNTP_TIME_SYNC_METHOD_CUSTOM
            bool "custom implementation"
    endchoice
endmenu
```
